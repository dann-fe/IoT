//===================================================================================
// Template v 001
//===================================================================================
// ----- global define ----------------------------------------------
//
// ----- libraries --------------------------------------------------
 #include <Servo.h>
// ----- constant pin -----------------------------------------------
#define srv 8
#define buzzer 6
// ----- constant common --------------------------------------------
// const float pi = 3.14;
// ----- variables --------------------------------------------------
 unsigned long count = 0;
 unsigned long count2 = 0;
 bool stat = true;
 bool stat2 = false;
// ----- prepare hardware -------------------------------------------
 Servo servo1;
// ==================================================================
// functions common -------------------------------------------------
// void control() {}
// ==================================================================
void setup() {
  // Serial monitor -------------------------------------------------
  Serial.begin(9600); delay(3000);
  // ----- prepare pins ---------------------------------------------
   pinMode(buzzer,OUTPUT);
  // ----- prepare variable -----------------------------------------
   count = millis();
   count2 = millis();
  // ----- prepare hardware -----------------------------------------
   servo1.attach(srv);
   servo1.write(0);
} // ================================================================
void loop() { // ----- work programm -----------------------------------------
  if ((millis() - count) > 1000) {
    if(stat == true) servo1.write(180);
    else servo1.write(0);
    stat =!stat;
    count = millis();
    
  }

  if ((millis() - count) > 500) {
    if(stat2 == true) tone(buzzer, 350);
    else noTone(buzzer);
    stat2 = !stat;
    count2 = millis();
  }
  
} // ================================================================
